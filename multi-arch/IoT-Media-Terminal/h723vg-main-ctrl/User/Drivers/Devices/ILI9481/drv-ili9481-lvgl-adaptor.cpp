/**
 *******************************************************************************
 * @file    drv-ili9481-lvgl-adaptor.cpp
 * @brief   简要描述
 *******************************************************************************
 * @attention
 *
 * none
 *
 *******************************************************************************
 * @note
 *
 * none
 *
 *******************************************************************************
 * @author  MekLi
 * @date    2025/11/30
 * @version 1.0
 *******************************************************************************
 */


/* ------- define ----------------------------------------------------------------------------------------------------*/





/* ------- include ---------------------------------------------------------------------------------------------------*/

#include "drv-ili9481-lvgl-adaptor.h"
#include "drv-ili9481.h"




/* ------- class prototypes-------------------------------------------------------------------------------------------*/





/* ------- macro -----------------------------------------------------------------------------------------------------*/





/* ------- variables -------------------------------------------------------------------------------------------------*/





/* ------- function implement ----------------------------------------------------------------------------------------*/


void lcdInit() {
    ILI9481::init();
}

void lcdFillRect(uint16_t x, uint16_t y, uint16_t endx, uint16_t endy, uint16_t* color) {

    // 越界检测（可根据你屏幕实际分辨率修改）

    uint16_t w = endx - x + 1;
    uint16_t h = endy - y + 1;

    if (w >= 480) w = 479;
    if (h >= 320) h = 319;

    // -----------------------------
    // 设置页地址 SET_PAGE_ADDR
    // -----------------------------
    __WRITE_REG((uint16_t)ILI9481_CMD::SET_PAGE_ADDR);
    __WRITE_DATA(x >> 8);
    __WRITE_DATA(x & 0xFF);
    __WRITE_DATA(endx>> 8);
    __WRITE_DATA(endx& 0xFF);

    // -----------------------------
    // 设置列地址 SET_COLUMN_ADDR
    // -----------------------------
    __WRITE_REG((uint16_t)ILI9481_CMD::SET_COL_ADDR);
    __WRITE_DATA(y >> 8);
    __WRITE_DATA(y & 0xFF);
    __WRITE_DATA(endy >> 8);
    __WRITE_DATA(endy & 0xFF);

    // -----------------------------
    // 开始写入像素数据 RAM WRITE
    // -----------------------------


    __WRITE_REG(ILI9481_CMD::WRITE_MEM_START);


    uint32_t total = w * h;

    for (uint16_t i = 0; i < w; i++) {
        for (uint16_t j = 0; j < h; j++) {
            __WRITE_DATA(color[j * w + i])
        }
    }

}
